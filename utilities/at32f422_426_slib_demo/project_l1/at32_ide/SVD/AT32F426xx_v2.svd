# AT32F426xx_v2 register map
Vendor: Keil; Series: AT32F426; File version: 1.0
ARM 32-bit Cortex-M4 Microcontroller based device, CPU clock up to 120MHz, etc.
CPU: CM4 r0p1, little endian, no MPU, FPU, 4 interrupt priority bits
Registers are 32-bit, read-write, reset 0x0 unless marked. A register's access mark holds for its fields unless they carry their own. Offsets are from the block's base; lines under a group give offsets from that group; [hi:lo] are bit positions; {n}, {i} and the like mark numbered series; 'fields as' and 'values as' point back to an identical list; <NAME> marks a mode.

## Memory map
0x40000400 TMR3 size 0x400 — General purpose timer
0x40001000 TMR6 size 0x400 — Basic timer
0x40002000 TMR4 size 0x400 — General purpose timer
0x40002800 ERTC size 0x400 — Real-time clock
0x40002C00 WWDT size 0x400 — Window watchdog
0x40003000 WDT size 0x400 — Watchdog
0x40003800 SPI2 size 0x400
0x40004400 USART2 size 0x400
0x40005400 I2C1 size 0x400 — Inter integrated circuit
0x40005800 I2C2 size 0x400
0x40006400 CAN1 size 0x400 — controller area network
0x40007000 PWC size 0x400 — Power control
0x40007400 DAC size 0x400 — Digital to analog converter
0x40010000 SCFG size 0x400 — System configuration controller
0x4001001C CMP size 0x3E4 — Comparator
0x40010400 EXINT size 0x400
0x40012400 ADC1 size 0x100 — Analog to digital converter
0x40012C00 TMR1 size 0x400 — Advanced timer
0x40013000 SPI1 size 0x400 — Serial peripheral interface
0x40013800 USART1 size 0x400 — Universal synchronous asynchronous receiver transmitter
0x40014000 TMR15 size 0x400 — General purpose timer
0x40014400 TMR16 size 0x400 — General purpose timer
0x40014800 TMR17 size 0x400
0x40017400 ACC size 0x400 — HICK Auto Clock Calibration
0x40020000 DMA1 size 0x200 — DMA controller
0x40021000 CRM size 0x400 — Clock and reset management
0x40022000 FLASH size 0x400 — Flash memory controler
0x40023000 CRC size 0x400 — CRC calculation unit
0x48000000 GPIOA size 0x400 — General purpose I/Os
0x48000400 GPIOB size 0x400
0x48000800 GPIOC size 0x400
0x48001400 GPIOF size 0x400
0xE000E000 NVIC size 0x1001 — Nested Vectored Interrupt Controller
0xE000EF34 FPU size 0xD — Floting point unit
0xE0042000 DEBUG size 0x400 — Debug support

## Interrupts
0 WWDT — Window Watchdog interrupt
1 PVM (EXINT) — PVM interrupt connect to EXINT line16
2 ERTC_ALARM_TAMP_STAMP (EXINT) — ERTC Tamper and Stamp interrupt connect to EXINT line17 and line19
3 FLASH — Flash global interrupt
4 CRM — CRM global interrupt
5 EXINT1_0 (EXINT) — EXINT Line0 interrupt
6 EXINT3_2 (EXINT) — EXINT Line2 interrupt
7 EXINT15_4 (EXINT) — EXINT Line4 interrupt
9 DMA1_Channel1 (DMA1) — DMA1 Channel1 global interrupt
10 DMA1_Channel3_2 (DMA1) — DMA1 Channel2 global interrupt
11 DMA1_Channel7_4 (DMA1) — DMA1 Channel4 global interrupt
12 ADC1_CMP1 (EXINT) — ADC1 and CMP1 interrupt connect to EXINT line 21
13 TMR1_BRK_OVF_TRG_HALL (TMR1) — TMR1 brake interrupt and TMR9 global interrupt
14 TMR1_CH (TMR1) — TMR1 channel interrupt
16 TMR3 — TMR3 global interrupt
19 TMR4 — TMR4 global interrupt
20 TMR15 — TMR15 global interrupt
21 TMR16 — TMR16 global interrupt
22 TMR17 — TMR17 global interrupt
23 I2C1_EVT (I2C1) — I2C1 event interrupt
24 I2C2_EVT (I2C2) — I2C2 event interrupt
25 SPI1 — SPI1 global interrupt
26 SPI2 — SPI2 global interrupt
27 USART1 — USART1 global interrupt
28 USART2 — USART2 global interrupt
30 CAN1_TX (CAN1) — CAN1 TX interrupt
31 CAN1_RX (CAN1) — CAN1 RX interrupt
32 I2C1_ERR (I2C1) — I2C1 error interrupt
34 I2C2_ERR (I2C2) — I2C2 error interrupt
35 CAN1_STAT (CAN1) — CAN1 status interrupt
36 CAN1_ERR (CAN1) — CAN1 error interrupt
37 FPU — Floating point unit interrupt
54 TMR6 — TMR6 global interrupt

## Licence text in the file
ARM Limited (ARM) is supplying this software for use with Cortex-M processor based microcontroller, but can be equally used for other suitable processor architectures. This file can be freely distributed. Modifications to this file shall be clearly marked. . THIS SOFTWARE IS PROVIDED "AS IS". NO WARRANTIES, WHETHER EXPRESS, IMPLIED. OR STATUTORY, INCLUDING, BUT NOT LIMITED TO, IMPLIED WARRANTIES OF. MERCHANTABILITY AND FITNESS FOR A PARTICULAR PURPOSE APPLY TO THIS SOFTWARE. ARM SHALL NOT, IN ANY CIRCUMSTANCES, BE LIABLE FOR SPECIAL, INCIDENTAL, OR. CONSEQUENTIAL DAMAGES, FOR ANY REASON WHATSOEVER.

## Notices in the file
Copyright (C) 2012-2014 ARM Limited. All rights reserved.
Purpose: System Viewer Description (SVD) Example (Schema Version 1.1)
This is a description of a none-existent and incomplete device
for demonstration purposes only.
Redistribution and use in source and binary forms, with or without
modification, are permitted provided that the following conditions are met:
- Redistributions of source code must retain the above copyright
notice, this list of conditions and the following disclaimer.
- Redistributions in binary form must reproduce the above copyright
notice, this list of conditions and the following disclaimer in the
documentation and/or other materials provided with the distribution.
- Neither the name of ARM nor the names of its contributors may be used
to endorse or promote products derived from this software without
specific prior written permission.
THIS SOFTWARE IS PROVIDED BY THE COPYRIGHT HOLDERS AND CONTRIBUTORS "AS IS"
AND ANY EXPRESS OR IMPLIED WARRANTIES, INCLUDING, BUT NOT LIMITED TO, THE
ARE DISCLAIMED. IN NO EVENT SHALL COPYRIGHT HOLDERS AND CONTRIBUTORS BE
LIABLE FOR ANY DIRECT, INDIRECT, INCIDENTAL, SPECIAL, EXEMPLARY, OR
CONSEQUENTIAL DAMAGES (INCLUDING, BUT NOT LIMITED TO, PROCUREMENT OF
SUBSTITUTE GOODS OR SERVICES; LOSS OF USE, DATA, OR PROFITS; OR BUSINESS
INTERRUPTION) HOWEVER CAUSED AND ON ANY THEORY OF LIABILITY, WHETHER IN
CONTRACT, STRICT LIABILITY, OR TORT (INCLUDING NEGLIGENCE OR OTHERWISE)
ARISING IN ANY WAY OUT OF THE USE OF THIS SOFTWARE, EVEN IF ADVISED OF THE
POSSIBILITY OF SUCH DAMAGE.
